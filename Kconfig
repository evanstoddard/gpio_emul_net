## Kconfig
```kconfig
menu "Emulated GPIO Driver"

config GPIO_EMUL_NET
    bool "Emulated GPIO over Network Socket"
    depends on GPIO && BOARD_NATIVE_SIM
    help
      Enable the GPIO emulated driver for native_sim target.

endmenu
```

## dts/bindings/gpio/zephyr,gpio-emul-net.yaml
```yaml
# Copyright 2022, Basalte bv
# SPDX-License-Identifier: Apache-2.0

description: Net GPIO Emulator 

compatible: "zephyr,gpio-emul-net"

include: base.yaml
```
